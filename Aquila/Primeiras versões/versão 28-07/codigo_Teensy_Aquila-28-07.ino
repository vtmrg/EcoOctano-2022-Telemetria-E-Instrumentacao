#include <SPI.h>  raio=8cm
#include <Wire.h>
#include <Adafruit_GFX.h>
#include <Adafruit_SSD1306.h>

#define TEMPOATT 200       
#define TEMPOATT2 1500      
#define TEMPOATT3 800   

const int OLED_RESET=-1, pinoInterrupt = 3, pinoBotao=10;
//#define OLED_RESET 4
const byte SCREEN_WIDTH = 128, SCREEN_HEIGHT = 64;         
int i_vel=0, dado1,dado2;
float t0=0,tempo_p0 =0,comprimento=0, periodo=0,circunferencia=0.503,velocidade_display=0,velocidade =0, tempo=0, tempoatualizacao=0;
char buffer[50];
String mensagem;
 
const unsigned char epd_bitmap_logoazul [] PROGMEM = {
 // 'logoazul, 64x64px
  0x00, 0x00, 0x00, 0x1f, 0xf8, 0x00, 0x00, 0x00, 0x00, 0x00, 0x01, 0xe0, 0x07, 0xc0, 0x00, 0x00, 
  0x00, 0x00, 0x0e, 0x00, 0x00, 0x70, 0x00, 0x00, 0x00, 0x00, 0x30, 0x00, 0x00, 0x0c, 0x00, 0x00, 
  0x00, 0x00, 0xc0, 0x00, 0x00, 0x03, 0x00, 0x00, 0x00, 0x03, 0x00, 0x00, 0x00, 0x00, 0xc0, 0x00, 
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  0x00, 0x00, 0x03, 0xe0, 0x07, 0xc0, 0x00, 0x00, 0x00, 0x00, 0x00, 0x3f, 0xfc, 0x00, 0x00, 0x00
};

Adafruit_SSD1306 display(SCREEN_WIDTH, SCREEN_HEIGHT, &Wire, OLED_RESET);

void setup()
{
  display.begin(SSD1306_SWITCHCAPVCC, 0x3C); 
  Serial.println("Inicializando");
  //drawlogo();
  Serial.begin(9600);
  Serial1.begin(115200); // comunicação com o esp
  pinMode(pinoInterrupt, INPUT);                                      
  attachInterrupt(digitalPinToInterrupt(pinoInterrupt), calculo_vel, RISING);    
}



void loop(){
  float tempo2=millis();
  tempo=millis();
  if (velocidade_display!=0.00 && ( (millis()-t0)> TEMPOATT2)) { 
    velocidade_display=0.00;
    Serial.println(" ");
    Serial.print("----- VEL REAL -----:");
    Serial.println(velocidade_display);
    }
    
   if( tempo > TEMPOATT3) {
     updt_display();   
     tempo=0;
     delay(500);
    }

  if(velocidade_display<10.00) { //para manter o padrão de dois dígitos, verificar se isso funciona na hora do esp32 receber
    int velocidade_serial=(int)velocidade_display;
    mensagem=String(velocidade_serial) ;
    mensagem="0"+String(velocidade_serial);
    Serial.print("mensgaem:");
    Serial.print(mensagem); 
    Serial1.print(mensagem); //comunicação com o esp
    Serial1.flush(); 
    }
   else{ 
    int velocidade_serial=(int)velocidade_display;
     mensagem=String(velocidade_serial) ;
    Serial.print("mensgaem:");
    Serial.print(mensagem); 
    Serial1.print(mensagem); //comunicação com o esp
    Serial1.flush(); 
    }
 
 delay(200);
}



void calculo_vel()      
{
   
    i_vel++; 
    
    if(i_vel>1)         
    {
        //periodo=((millis()-tempo_p0)*2.0); //dois imas
        periodo=(millis()-tempo_p0); 
        tempo_p0=millis();
        i_vel=0;
        //if(periodo!=0.000000000)
        if(periodo>32) // periodo para 55 km/h = 32.92 s 
        {
        comprimento = 3600.0*circunferencia;
        velocidade = (comprimento/periodo);
                
        }
        
    }
     
     
     if((millis()-t0)>TEMPOATT){
        velocidade_display=velocidade; 
        Serial.println(" ");
        Serial.print("----- VEL REAL -----:");
        Serial.println(velocidade_display);
        t0=millis();
        }
                             
}


void updt_display()      
{
  Serial.println(" ");
  Serial.print("----- DISPLAY ----- :");
  Serial.println(velocidade_display);
  draw(velocidade_display);
                             
}



void draw(float dado_velocidade) {
 int exibicao;
exibicao=int(dado_velocidade);
display.clearDisplay();  
display.setTextSize(8.7);
display.setTextColor(WHITE);
display.setCursor(22,7);
display.println(exibicao);
display.display();
}


void drawlogo() {
display.clearDisplay();
display.drawBitmap(32, 0, epd_bitmap_logoazul , 64, 64, 1); // (0,0) posicao no display, (128,64) tam. da img., (conix_64x64) image name.
display.display();
delay(1500);
}
